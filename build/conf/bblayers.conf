## meta-rtos/conf/layer.conf
```bitbake
BBPATH .= ":${LAYERDIR}"
BBFILES += "${LAYERDIR}/recipes-*/*/*.bb \
            ${LAYERDIR}/recipes-*/*/*.bbappend"
BBFILE_COLLECTIONS += "rtos"
BBFILE_PATTERN_rtos = "^${LAYERDIR}/"
BBFILE_PRIORITY_rtos = "1"
LAYERVERSION_rtos = "1"
LAYERSERIES_COMPAT_rtos = "bitbakeguilde"
LAYERSERIES_CORENAMES = "bitbakeguilde"
```
